## config/west.yml
```yaml
manifest:
  remotes:
    - name: zmkfirmware
      url-base: https://github.com/zmkfirmware
      # Additional modules containing boards/shields/custom code can be listed here as well.
      # See:
      # - https://zmk.dev/docs/features/modules
      # - https://docs.zephyrproject.org/3.5.0/develop/west/manifest.html#projects
    # - name: gpeye #mario animation
    #   url-base: https://github.com/GPeye #mario animation
    - name: m165437 #gem animation
      url-base: https://github.com/M165437 #gem animation
  projects:
    - name: eyelash_sofle
      url: https://github.com/a741725193/zmk-sofle
      revision: refactor
    # - name: mario-peripheral-animation #mario animation
    #   remote: gpeye #mario animation
    #   revision: main #mario animation
    - name: nice-view-gem #gem animation
      remote: m165437 #gem animation
      revision: main #gem animation
    - name: zmk
      remote: zmkfirmware
      revision: main
      import: app/west.yml
  self:
    path: config
```
